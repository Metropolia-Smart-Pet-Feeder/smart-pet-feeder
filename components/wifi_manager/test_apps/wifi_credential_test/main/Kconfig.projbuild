## components/wifi_manager/test_apps/wifi_credential_test/main/Kconfig.projbuild
```kconfig
menu "Test WiFi Credentials"

    config TEST_WIFI_SSID
        string "WiFi SSID"
        default "YOUR_SSID"
        help
            SSID for WiFi credential test.

    config TEST_WIFI_PASSWORD
        string "WiFi Password"
        default "YOUR_PASSWORD"
        help
            Password for WiFi credential test.

endmenu
```

## test_apps/ui_wifi_provisioning/sdkconfig.defaults
```kconfig
CONFIG_IDF_TARGET="esp32s3"
CONFIG_ESPTOOLPY_FLASHSIZE_4MB=y
CONFIG_PARTITION_TABLE_CUSTOM=y
CONFIG_PARTITION_TABLE_CUSTOM_FILENAME="partitions.csv"
CONFIG_LV_CONF_SKIP=n
CONFIG_BT_ENABLED=y
CONFIG_BT_NIMBLE_ENABLED=y
```
